## config/nxp/chip-module/Kconfig.features
```kconfig
#
#   Copyright (c) 2023 Project CHIP Authors
#
#   Licensed under the Apache License, Version 2.0 (the "License");
#   you may not use this file except in compliance with the License.
#   You may obtain a copy of the License at
#
#       http://www.apache.org/licenses/LICENSE-2.0
#
#   Unless required by applicable law or agreed to in writing, software
#   distributed under the License is distributed on an "AS IS" BASIS,
#   WITHOUT WARRANTIES OR CONDITIONS OF ANY KIND, either express or implied.
#   See the License for the specific language governing permissions and
#   limitations under the License.
#

# The purpose of this file is to define Kconfig options enabling specific features.
# Feature options will define defaults for settings that are related to the specific feature.

if CHIP

config CHIP_WIFI
	bool "Enable NXP Wi-Fi support"
	default y
	select WIFI
	select WIFI_NXP
	select WPA_SUPP
	select WPA_SUPP_AP
	select WPA_SUPP_CRYPTO
	select WPA_SUPP_WPS
	select WPA_SUPP_WPA3
	select WPA_SUPP_CRYPTO_ENTERPRISE
	select POSIX_CLOCK
	select NET_IPV4
	select NET_IPV6
	select NET_DHCPV4
	select NET_MGMT_EVENT
	select NET_L2_ETHERNET
	select MBEDTLS_ENTROPY_C
	imply NET_STATISTICS
	imply NET_PKT_TXTIME
	imply NET_PKT_TIMESTAMP
	imply NET_IPV6_ND # enable Neighbor Discovery to handle Router Advertisements
	imply NET_IPV6_NBR_CACHE
	imply NET_STATISTICS_IPV6
	imply NET_STATISTICS_USER_API

config CHIP_WIFI_CONNECTION_RECOVERY_MINIMUM_INTERVAL
	int "Define the minimum connection recovery time interval in milliseconds"
	depends on CHIP_WIFI
	default 500
	help
	  Specifies the minimum connection recovery interval (in milliseconds).

config CHIP_WIFI_CONNECTION_RECOVERY_MAXIMUM_INTERVAL
	int "Define the maximum connection recovery time interval in milliseconds"
	depends on CHIP_WIFI
	default 3600000 # 1 hour
	help
	  Specifies the maximum connection recovery interval (in milliseconds).

config CHIP_WIFI_CONNECTION_RECOVERY_MAX_RETRIES_NUMBER
	int "Define the maximum amount of connection recovery occurrences"
	depends on CHIP_WIFI
	default 0
	help
	  Specifies the maximum number of connection recovery attempts.
	  If set to 0, no limitation is applied and attempts
	  to recover the connection are performed indefinitely.

config CHIP_WIFI_CONNECTION_RECOVERY_JITTER
	int "Define the connection recovery jitter in milliseconds"
	depends on CHIP_WIFI
	default 2000
	help
	  Specifies the maximum connection recovery jitter interval (in milliseconds).
	  Once the wait time reaches the current maximum value (defined by CHIP_WIFI_CONNECTION_RECOVERY_MAXIMUM_INTERVAL),
	  a random jitter interval is added to it to avoid periodicity. The random jitter is selected
	  within range [-JITTER; +JITTER].

config CHIP_ICD_SUBSCRIPTION_HANDLING
	bool "Enables platform specific handling of ICD subscriptions"
	help
	  Enables platform specific implementation that handles ICD subscription requests
	  and selects subscription report interval value considering maximum interval preferred
	  by the publisher.

if CHIP_ICD_SUBSCRIPTION_HANDLING

config CHIP_MAX_PREFERRED_SUBSCRIPTION_REPORT_INTERVAL
	int "Maximum preferred interval of sending subscription reports (s)"
	default 60
	help
	  Provides maximum preferred interval to be used by a publisher for negotiation
	  of the final maximum subscription report interval, after receiving a subscription
	  request from the initiator. This value should be selected as a compromise between
	  keeping the power consumption low due to not sending reports too often, and allowing
	  the initiator device to detect the publisher absence reasonably fast due to not sending
	  the reports too rarely. The current algorithm is to select bigger value from the one
	  requested by the initiator and the one preferred by the publisher.

endif # CHIP_ICD_SUBSCRIPTION_HANDLING

endif # CHIP
```

## examples/all-clusters-app/nxp/zephyr/Kconfig
```kconfig
#
#    Copyright (c) 2023 Project CHIP Authors
#
#    Licensed under the Apache License, Version 2.0 (the "License");
#    you may not use this file except in compliance with the License.
#    You may obtain a copy of the License at
#
#        http://www.apache.org/licenses/LICENSE-2.0
#
#    Unless required by applicable law or agreed to in writing, software
#    distributed under the License is distributed on an "AS IS" BASIS,
#    WITHOUT WARRANTIES OR CONDITIONS OF ANY KIND, either express or implied.
#    See the License for the specific language governing permissions and
#    limitations under the License.
#
mainmenu "Matter NXP All Clusters Example Application"

rsource "../../../../config/nxp/chip-module/Kconfig.features"
rsource "../../../../config/nxp/chip-module/Kconfig.defaults"
source "Kconfig.zephyr"

choice CHIP_APP_DEVICE_TYPE
    prompt "Choose app device type"
    default CHIP_APP_DEVICE_TYPE_THERMOSTAT

    config CHIP_APP_DEVICE_TYPE_ALL_CLUSTERS
        bool "Build as all-clusters device type."
        help
          Build the application as a full all-clusters application.

    config CHIP_APP_DEVICE_TYPE_THERMOSTAT
        bool "Build as a thermostat."
        help
          Build the application as a thermostat device.

endchoice
```

## examples/all-clusters-app/nxp/zephyr/sample.yaml
```yaml
sample:
  name: Matter
tests:
  sample.matter.all_cluster_app:
    platform_allow:
      - rd_rw612_bga
    build_only: true
    tags: matter
  sample.matter.all_cluster_app_no_factory_data:
    platform_allow:
      - rd_rw612_bga
    build_only: true
    tags: matter
    extra_args: CONF_FILE="prj_nofdata.conf"
  sample.matter.all_cluster_app_ota_v0:
    platform_allow:
      - rd_rw612_bga
    build_only: true
    tags: matter
    extra_args: EXTRA_CONF_FILE="prj_ota.conf"
  sample.matter.all_cluster_app_ota_v1:
    platform_allow:
      - rd_rw612_bga
    build_only: true
    tags: matter
    extra_args: EXTRA_CONF_FILE="prj_ota.conf"
    extra_configs:
      - CONFIG_CHIP_DEVICE_SOFTWARE_VERSION=1
  sample.matter.all_cluster_app_a1:
    platform_allow:
      - rd_rw612_bga
    build_only: true
    tags: matter
    extra_configs:
      - CONFIG_SOC_SERIES_RW6XX_REVISION_A2=n
      - CONFIG_SOC_SERIES_RW6XX_REVISION_A1=y
  sample.matter.all_cluster_app_no_factory_data_a1:
    platform_allow:
      - rd_rw612_bga
    build_only: true
    tags: matter
    extra_args: CONF_FILE="prj_nofdata.conf"
    extra_configs:
      - CONFIG_SOC_SERIES_RW6XX_REVISION_A2=n
      - CONFIG_SOC_SERIES_RW6XX_REVISION_A1=y
  sample.matter.all_cluster_app_ota_v0_a1:
    platform_allow:
      - rd_rw612_bga
    build_only: true
    tags: matter
    extra_args: EXTRA_CONF_FILE="prj_ota.conf"
    extra_configs:
      - CONFIG_SOC_SERIES_RW6XX_REVISION_A2=n
      - CONFIG_SOC_SERIES_RW6XX_REVISION_A1=y
  sample.matter.all_cluster_app_ota_v1_a1:
    platform_allow:
      - rd_rw612_bga
    build_only: true
    tags: matter
    extra_args: EXTRA_CONF_FILE="prj_ota.conf"
    extra_configs:
      - CONFIG_CHIP_DEVICE_SOFTWARE_VERSION=1
      - CONFIG_SOC_SERIES_RW6XX_REVISION_A2=n
      - CONFIG_SOC_SERIES_RW6XX_REVISION_A1=y
```

## examples/laundry-dryer-app/nxp/zephyr/sample.yaml
```yaml
sample:
  name: Matter
tests:
  sample.matter.laundry_dryer_app_no_factorydata:
    platform_allow:
      - rd_rw612_bga
    build_only: true
    tags: matter
  sample.matter.laundry_dryer_app_factorydata:
    platform_allow:
      - rd_rw612_bga
    build_only: true
    tags: matter
    extra_args: FILE_SUFFIX="fdata"
  sample.matter.laundry_dryer_app_factorydata_ota_v0:
    platform_allow:
      - rd_rw612_bga
    build_only: true
    tags: matter
    extra_args:
      - FILE_SUFFIX="fdata"
      - EXTRA_CONF_FILE="prj_ota.conf"
  sample.matter.laundry_dryer_app_factorydata_ota_v1:
    platform_allow:
      - rd_rw612_bga
    build_only: true
    tags: matter
    extra_args:
      - FILE_SUFFIX="fdata"
      - EXTRA_CONF_FILE="prj_ota.conf"
    extra_configs:
      - CONFIG_CHIP_DEVICE_SOFTWARE_VERSION=2
  sample.matter.laundry_dryer_app_no_factorydata_a1:
    platform_allow:
      - rd_rw612_bga
    build_only: true
    tags: matter
    extra_configs:
      - CONFIG_SOC_SERIES_RW6XX_REVISION_A2=n
      - CONFIG_SOC_SERIES_RW6XX_REVISION_A1=y
  sample.matter.laundry_dryer_app_factorydata_a1:
    platform_allow:
      - rd_rw612_bga
    build_only: true
    tags: matter
    extra_args: FILE_SUFFIX="fdata"
    extra_configs:
      - CONFIG_SOC_SERIES_RW6XX_REVISION_A2=n
      - CONFIG_SOC_SERIES_RW6XX_REVISION_A1=y
  sample.matter.laundry_dryer_app_factorydata_ota_v0_a1:
    platform_allow:
      - rd_rw612_bga
    build_only: true
    tags: matter
    extra_args:
      - FILE_SUFFIX="fdata"
      - EXTRA_CONF_FILE="prj_ota.conf"
    extra_configs:
      - CONFIG_SOC_SERIES_RW6XX_REVISION_A2=n
      - CONFIG_SOC_SERIES_RW6XX_REVISION_A1=y
  sample.matter.laundry_dryer_app_factorydata_ota_v1_a1:
    platform_allow:
      - rd_rw612_bga
    build_only: true
    tags: matter
    extra_args:
      - FILE_SUFFIX="fdata"
      - EXTRA_CONF_FILE="prj_ota.conf"
    extra_configs:
      - CONFIG_CHIP_DEVICE_SOFTWARE_VERSION=2
      - CONFIG_SOC_SERIES_RW6XX_REVISION_A2=n
      - CONFIG_SOC_SERIES_RW6XX_REVISION_A1=y
```

## examples/laundry-washer-app/nxp/zephyr/sample.yaml
```yaml
sample:
  name: Matter
tests:
  sample.matter.laundry_washer_app:
    platform_allow:
      - rd_rw612_bga
    build_only: true
    tags: matter
  sample.matter.laundry_washer_app_no_factory_data:
    platform_allow:
      - rd_rw612_bga
    build_only: true
    tags: matter
    extra_args: CONF_FILE="prj_nofdata.conf"
  sample.matter.laundry_washer_app_ota_v0:
    platform_allow:
      - rd_rw612_bga
    build_only: true
    tags: matter
    extra_args: EXTRA_CONF_FILE="prj_ota.conf"
  sample.matter.laundry_washer_app_ota_v1:
    platform_allow:
      - rd_rw612_bga
    build_only: true
    tags: matter
    extra_args: EXTRA_CONF_FILE="prj_ota.conf"
    extra_configs:
      - CONFIG_CHIP_DEVICE_SOFTWARE_VERSION=1
  sample.matter.laundry_washer_app_a1:
    platform_allow:
      - rd_rw612_bga
    build_only: true
    tags: matter
    extra_configs:
      - CONFIG_SOC_SERIES_RW6XX_REVISION_A2=n
      - CONFIG_SOC_SERIES_RW6XX_REVISION_A1=y
  sample.matter.laundry_washer_app_no_factory_data_a1:
    platform_allow:
      - rd_rw612_bga
    build_only: true
    tags: matter
    extra_args: CONF_FILE="prj_nofdata.conf"
    extra_configs:
      - CONFIG_SOC_SERIES_RW6XX_REVISION_A2=n
      - CONFIG_SOC_SERIES_RW6XX_REVISION_A1=y
  sample.matter.laundry_washer_app_ota_v0_a1:
    platform_allow:
      - rd_rw612_bga
    build_only: true
    tags: matter
    extra_args: EXTRA_CONF_FILE="prj_ota.conf"
    extra_configs:
      - CONFIG_SOC_SERIES_RW6XX_REVISION_A2=n
      - CONFIG_SOC_SERIES_RW6XX_REVISION_A1=y
  sample.matter.laundry_washer_app_ota_v1_a1:
    platform_allow:
      - rd_rw612_bga
    build_only: true
    tags: matter
    extra_args: EXTRA_CONF_FILE="prj_ota.conf"
    extra_configs:
      - CONFIG_CHIP_DEVICE_SOFTWARE_VERSION=1
      - CONFIG_SOC_SERIES_RW6XX_REVISION_A2=n
      - CONFIG_SOC_SERIES_RW6XX_REVISION_A1=y
```

## examples/thermostat/nxp/zephyr/sample.yaml
```yaml
sample:
  name: Matter
tests:
  sample.matter.thermostat:
    platform_allow:
      - rd_rw612_bga
    build_only: true
    tags: matter
  sample.matter.thermostat_factory_data:
    platform_allow:
      - rd_rw612_bga
    build_only: true
    tags: matter
    extra_args: CONF_FILE="prj_fdata.conf"
  sample.matter.thermostat_ota_v0:
    platform_allow:
      - rd_rw612_bga
    build_only: true
    tags: matter
    extra_args: EXTRA_CONF_FILE="prj_ota.conf"
  sample.matter.thermostat_ota_v1:
    platform_allow:
      - rd_rw612_bga
    build_only: true
    tags: matter
    extra_args: EXTRA_CONF_FILE="prj_ota.conf"
    extra_configs:
      - CONFIG_CHIP_DEVICE_SOFTWARE_VERSION=1
```

## third_party/nxp/github_sdk/k32w0/manifest/west.yml
```yaml
# The west manifest file (west.yml) for MCUXpresso SDK delivery.
#
# See the west documentation for more information:
#
# https://docs.zephyrproject.org/latest/guides/west/index.html
manifest:
  projects:
    - name: mcux-sdk-k32w0-2.6.14
      url: https://github.com/nxp-mcuxpresso/mcux-sdk.git
      revision: MCUX_2.6.14_K32W0
      path: core
      import:
        name-allowlist:
          - mcux-sdk
          - mcux-sdk-examples
          - mcux-sdk-middleware-connectivity-framework
          - mcux-sdk-middleware-bluetooth-controller
          - mcux-sdk-middleware-bluetooth-host
          - mcux-sdk-middleware-ieee_802.15.4
          - mbedtls
          - amazon-freertos
        path-prefix: repo
```

## third_party/nxp/github_sdk/rt/manifest/west.yml
```yaml
# The west manifest file (west.yml) for MCUXpresso SDK delivery.
#
# See the west documentation for more information:
#
# https://docs.zephyrproject.org/latest/guides/west/index.html
manifest:
  projects:
    - name: sdk-release
      url: https://github.com/nxp-mcuxpresso/mcux-sdk.git
      revision: MCUX_2.15.100
      path: core
      import:
        name-allowlist:
          - mcux-sdk
          - FreeRTOS-Kernel
          - CMSIS_5
          - mcux-sdk-middleware-sdmmc
          - mcux-sdk-middleware-connectivity-framework
          - fatfs
          - mcux-sdk-middleware-edgefast-bluetooth
          - mcux-sdk-middleware-ethermind
          - mbedtls
          - lwip
          - littlefs
          - mcuboot
          - mcux-sdk-examples
          - wifi_nxp
        path-prefix: repo/sdk-2.15
```

## third_party/nxp/github_sdk/rw_k32w1/manifest/west.yml
```yaml
# The west manifest file (west.yml) for MCUXpresso SDK delivery.
#
# See the west documentation for more information:
#
# https://docs.zephyrproject.org/latest/guides/west/index.html
manifest:
  projects:
    - name: core
      url: https://github.com/nxp-mcuxpresso/mcux-sdk.git
      revision: MCUX_2.15.000_RW610_K32W1
      import:
        name-allowlist:
          - CMSIS_5
          - fatfs
          - FreeRTOS-Kernel
          - littlefs
          - lwip
          - mbedtls
          - mcuboot
          - mcux-sdk-examples
          - mcux-sdk-middleware-bluetooth-controller
          - mcux-sdk-middleware-bluetooth-host
          - mcux-sdk-middleware-connectivity-framework
          - mcux-sdk-middleware-edgefast-bluetooth
          - mcux-sdk-middleware-ethermind
          - mcux-sdk-middleware-ieee_802.15.4
          - mcux-sdk-middleware-multicore
          - rpmsg-lite
          - mcux-secure-subsystem
          - wifi_nxp
        path-prefix: repo/sdk-2.15
```

## third_party/nxp/rt_sdk/repo/manifest/west.yml
```yaml
# The west manifest file (west.yml) for MCUXpresso SDK delivery.
#
# See the west documentation for more information:
#
# https://docs.zephyrproject.org/latest/guides/west/index.html
manifest:
  projects:
    - name: mcux-sdk
      url: https://github.com/nxp-mcuxpresso/mcux-sdk.git
      revision: MCUX_2.15.000
      path: core
      import:
        name-allowlist:
          - FreeRTOS-Kernel
          - CMSIS_5
          - mcux-sdk-middleware-sdmmc
          - mcux-sdk-middleware-connectivity-framework
          - fatfs
          - mcux-sdk-middleware-edgefast-bluetooth
          - mcux-sdk-middleware-ethermind
          - mbedtls
          - wifi_nxp
          - lwip
          - littlefs
          - mcuboot
        path-prefix: sdk-2.15
    - name: mcux-sdk-examples
      url: https://github.com/nxp-mcuxpresso/mcux-sdk-examples.git
      revision: MCUX_2.15.000_RT1170
      path: sdk-2.15/examples
```
